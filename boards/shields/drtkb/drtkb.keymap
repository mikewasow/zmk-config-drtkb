#include <behaviors.dtsi>
#include <dt-bindings/zmk/keys.h>

/ {
    keymap {
        compatible = "zmk,keymap";

        default_layer {
            display-name = "Base"
// ----------------------------------------------------------------------------------------------------------------------------
// |    Q    |    W    |    E    |    R    |    T    |                      |    Y    |    U    |    I    |    O    |    P    |
// |    A    |    S    |    D    |    F    |    G    |                      |    H    |    J    |    K    |    L    |    ;    |
// |    Z    |    X    |    C    |    V    |    B    |                      |    N    |    M    |    ,    |    .    |    /    |
//                     |   ESC   |  SPACE  |   DEL   |                      |  BSPC   |  SPACE  | RETURN  |
            bindings = <
    &kp Q    &kp W    &kp E     &kp R     &kp T                          &kp Y     &kp U     &kp I     &kp O     &kp P   
    &kp A    &kp S    &kp D     &kp F     &kp G                          &kp H     &kp J     &kp K     &kp L     &kp SEMI
    &kp Z    &kp X    &kp C     &kp V     &kp B                          &kp N     &kp M     &kp COMMA &kp DOT   &kp FSLH
                      &kp ESC   &kp SPACE &kp DEL                        &kp BSPC  &kp SPACE &kp RET
            >;
        };
    };
};
