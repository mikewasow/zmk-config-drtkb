## boards/shields/drtkb/Kconfig.defconfig
```kconfig
if SHIELD_DRTKB_LEFT

# Name must be less than 16 characters long!
config ZMK_KEYBOARD_NAME
    default "drtkb"

config ZMK_SPLIT_ROLE_CENTRAL
    default y

endif

if SHIELD_DRTKB_LEFT || SHIELD_DRTKB_RIGHT

config ZMK_SPLIT
    default y

endif
```

## boards/shields/drtkb/Kconfig.shield
```kconfig
config SHIELD_DRTKB_LEFT
    def_bool $(shields_list_contains,drtkb_left)

config SHIELD_DRTKB_RIGHT
    def_bool $(shields_list_contains,drtkb_right)
```
